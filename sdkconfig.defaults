## sdkconfig.defaults
```kconfig
CONFIG_BT_ENABLED=y
CONFIG_BTDM_CTRL_MODE_BLE_ONLY=y
CONFIG_BTDM_CTRL_MODE_BR_EDR_ONLY=n
CONFIG_BTDM_CTRL_MODE_BTDM=n
CONFIG_BT_BLE_ENABLED=y

# required for arduino core
CONFIG_FREERTOS_HZ=1000

CONFIG_PARTITION_TABLE_SINGLE_APP_LARGE=y

CONFIG_ESP_TIMER_TASK_STACK_SIZE=8192
CONFIG_FREERTOS_TIMER_TASK_STACK_DEPTH=8192
CONFIG_HTTPD_WS_SUPPORT=y
```
